// skeletyl_right.overlay
 
#include "skeletyl.dtsi"
 
&default_transform { // Right side starts from the 6th column, skipping 5 columns
    col-offset = <5>;
};
 
&kscan0 {
    row-gpios
        = <&pro_micro 10 (GPIO_ACTIVE_HIGH)> // row0 C3 009 D10
        , <&pro_micro 21 (GPIO_ACTIVE_HIGH)> // row1 R1 031 D21
        , <&pro_micro 20 (GPIO_ACTIVE_HIGH)> // row2 C2 029 D20
        , <&pro_micro 19 (GPIO_ACTIVE_HIGH)> // row3 C1 002 D19
        ; 
    col-gpios
        = <&pro_micro 4 (GPIO_ACTIVE_HIGH | GPIO_PULL_DOWN)> // col5 R4 022 D4
        , <&pro_micro 5 (GPIO_ACTIVE_HIGH | GPIO_PULL_DOWN)> // col6 R3 024 D5
        , <&pro_micro 6 (GPIO_ACTIVE_HIGH | GPIO_PULL_DOWN)> // col7 C4 100 D6
        , <&pro_micro 7 (GPIO_ACTIVE_HIGH | GPIO_PULL_DOWN)> // col8 C5 011 D7
        , <&pro_micro 8 (GPIO_ACTIVE_HIGH | GPIO_PULL_DOWN)> // col9 C6 104 D8
        ;
};